## drivers/oplus/Kconfig
```kconfig
# SPDX-License-Identifier: GPL-2.0-only
# Copyright (C) 2018-2023 Oplus. All rights reserved.

menu "OPLUS's custom device support"
	depends on !UML

config REGULATOR_FAN49103
	tristate "Fairchild FAN49103 Regulator"
	depends on I2C
	help
	  This driver supports Fairchild FAN49103 Digitally Programmable
	  TinyBuck Regulator. The FAN49103 is a step-down switching voltage
	  regulator that delivers a digitally programmable output from an
	  input voltage supply of 2.8V to 4V. The output voltage is
	  programmed through an I2C interface.

source "drivers/oplus/boot/Kconfig"

source "drivers/oplus/snshub/Kconfig"

source "drivers/oplus/feedback/Kconfig"

source "drivers/oplus/net/Kconfig"

source "drivers/oplus/aw86927_haptic/Kconfig"
source "drivers/oplus/startup_monitor/Kconfig"
endmenu
```

## drivers/oplus/boot/Kconfig
```kconfig
# SPDX-License-Identifier: GPL-2.0-only
# Copyright (C) 2018-2023 Oplus. All rights reserved.

source "drivers/oplus/boot/cmdline_parser/Kconfig"
source "drivers/oplus/boot/oplus_project/Kconfig"
source "drivers/oplus/boot/project_info/Kconfig"
```

## drivers/oplus/net/Kconfig
```kconfig
config OPLUS_NET_LINK_POWER
	tristate "config oplus net linkpower"
	help
	  define this config to define LINK_POWER
```

## drivers/oplus/snshub/Kconfig
```kconfig
# SPDX-License-Identifier: GPL-2.0-only
# Copyright (C) 2018-2020 Oplus. All rights reserved.

config OPLUS_SNSHUB
	tristate "Oplus sensor hub"
	default n
	help
	  Oplus mcu sensor hub misc driver

config OPLUS_INTER_CHIP_COMM
	tristate "Oplus Inter-chip communication driver"
	default n
	help
	  Oplus Inter-chip communication master driver

config OPLUS_INTER_CHIP_COMM_BT
	tristate "Oplus Inter-chip communication bt driver"
	default n
	help
	  Oplus Inter-chip communication master bt driver
```

## drivers/oplus/startup_monitor/Kconfig
```kconfig
config OPLUS_FEATURE_STARTUP_MONITOR
	tristate "startup_monitor"
	default n
	help
             define this config to enable startup_monitor.
```
